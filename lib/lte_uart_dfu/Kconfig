## lib/lte_uart_dfu/Kconfig
```kconfig
#
# Copyright (c) 2018 Nordic Semiconductor
#
# SPDX-License-Identifier: LicenseRef-BSD-5-Clause-Nordic
#

menu "LTE UART DFU library"

# TODO: Consider whether depends on or select should be used here?
config LTE_UART_DFU
	bool "LTE UART DFU library"
	depends on DFU_TARGET
	depends on DFU_TARGET_MCUBOOT
	# TODO: Consider if these are needed?
	depends on SERIAL
	depends on UART_INTERRUPT_DRIVEN

if LTE_UART_DFU

choice
	prompt "UART for LTE UART DFU"
	default LTE_UART_DFU_UART_1
	depends on LTE_UART_DFU
	help
		Sets the UART to use for the LTE UART DFU
		-  UART 0
		-  UART 1
	config LTE_UART_DFU_UART_0
		bool "UART 0"
		# TODO: Consider whether depends on or select should be used here?
		depends on UART_0_NRF_UARTE
		depends on UART_0_NRF_FLOW_CONTROL 
	config LTE_UART_DFU_UART_1
		bool "UART 1"
		# TODO: Consider whether depends on or select should be used here?
		depends on UART_1_NRF_UARTE
		depends on UART_1_NRF_FLOW_CONTROL
endchoice

# TODO: Consider if choice should be used here
config LTE_UART_DFU_UART_LABEL
	string
	default "UART_0" if LTE_UART_DFU_UART_0
	default "UART_1" if LTE_UART_DFU_UART_1

endif # LTE_UART_DFU

endmenu
```

## lib/uart_blob/Kconfig
```kconfig
#
# Copyright (c) 2020 Nordic Semiconductor
#
# SPDX-License-Identifier: LicenseRef-BSD-5-Clause-Nordic
#

menu "UART BLOB transfer"
	depends on UART_COBS

config UART_BLOB
	bool
	help
	  Enabled whenever either the UART_BLOB_TX or UART_BLOB_RX modules are
	  enabled.


# UART BLOB sender configuration

config UART_BLOB_TX
	bool "UART BLOB sender"
	select UART_BLOB
	depends on UART_COBS
	help
	  Enable module for sending Binary Large OBjects (BLOBs) over UART.

if UART_BLOB_TX

config UART_BLOB_TX_SEND_TIMEOUT
	int "UART BLOB sender send timeout (ms)"
	default 1000
	help
	  Packet send timeout in milliseconds for the UART BLOB sender.

config UART_BLOB_TX_RESPONSE_TIMEOUT
	int "UART BLOB sender response timeout (ms)"
	default 10000
	help
	  Packet receive timeout in milliseconds for the UART BLOB sender.

module=UART_BLOB_TX
module-str=UART BLOB sender
source "${ZEPHYR_BASE}/subsys/logging/Kconfig.template.log_config"

endif # UART_BLOB_TX


# UART BLOB receiver configuration

config UART_BLOB_RX
	bool "UART BLOB receiver"
	select UART_BLOB
	depends on UART_COBS
	help
	  Enable module for receiving Binary Large OBjects (BLOBs) over UART.

if UART_BLOB_RX

config UART_BLOB_RX_SEND_TIMEOUT
	int "UART BLOB receiver send timeout (ms)"
	default 1000
	help
	  Packet send timeout in milliseconds for the UART BLOB receiver.

config UART_BLOB_RX_RESPONSE_TIMEOUT
	int "UART BLOB receiver response timeout (ms)"
	default 10000
	help
	  Packet receive timeout in milliseconds for the UART BLOB receiver.

module=UART_BLOB_RX
module-str=UART BLOB receiver
source "${ZEPHYR_BASE}/subsys/logging/Kconfig.template.log_config"

endif # UART_BLOB_RX

endmenu
```

## lib/uart_cobs/Kconfig
```kconfig
#
# Copyright (c) 2020 Nordic Semiconductor
#
# SPDX-License-Identifier: LicenseRef-BSD-5-Clause-Nordic
#

menu "UART COBS library"

# UART COBS module configuration

config UART_COBS
	bool "UART COBS library"
	depends on SERIAL
	depends on UART_ASYNC_API

config UART_COBS_THREAD_PRIO
	int "UART COBS library workqueue thread priority level"
	range 0 NUM_PREEMPT_PRIORITIES
	default 0 if !MULTITHREADING
	default 10

config UART_COBS_THREAD_STACK_SIZE
	int "UART COBS library workqueue thread stack size"
	default 1024

module=UART_COBS
module-str=UART COBS library
source "${ZEPHYR_BASE}/subsys/logging/Kconfig.template.log_config"

endmenu
```

## lib/uart_dfu/Kconfig
```kconfig
#
# Copyright (c) 2020 Nordic Semiconductor
#
# SPDX-License-Identifier: LicenseRef-BSD-5-Clause-Nordic
#

menu "UART DFU Library"

# UART DFU library configuration

config UART_DFU_LIBRARY
	bool "UART DFU library"
	depends on SERIAL
	depends on UART_ASYNC_API
	depends on UART_DFU_CLI || UART_DFU_SRV

config UART_DFU_LIBRARY_THREAD_PRIO
	int "UART DFU library workqueue thread priority level"
	range 0 NUM_PREEMPT_PRIORITIES
	default 0 if !MULTITHREADING
	default 10

config UART_DFU_LIBRARY_THREAD_STACK_SIZE
	int "UART DFU library workqueue thread stack size"
	default 1024

config UART_DFU_DEFAULT_SEND_TIMEOUT
	int # Default send timeout (ms)
	default 1000

config UART_DFU_DEFAULT_RESPONSE_TIMEOUT
	int # Default response timeout (ms)
	default 10000


# UART DFU client configuration

config UART_DFU_CLI
	bool "UART DFU client"
	default n

if UART_DFU_CLI

config UART_DFU_CLI_SEND_TIMEOUT
	int "UART DFU client send timeout (ms)"
	default UART_DFU_DEFAULT_SEND_TIMEOUT

config UART_DFU_CLI_RESPONSE_TIMEOUT
	int "UART DFU client response timeout (ms)"
	default UART_DFU_DEFAULT_RESPONSE_TIMEOUT

endif # UART_DFU_CLI


# UART DFU server configuration

config UART_DFU_SRV
	bool "UART DFU server"
	default n

if UART_DFU_SRV

config UART_DFU_SRV_SEND_TIMEOUT
	int "UART DFU server send timeout (ms)"
	default UART_DFU_DEFAULT_SEND_TIMEOUT

config UART_DFU_SRV_RESPONSE_TIMEOUT
	int "UART DFU server response timeout (ms)"
	default UART_DFU_DEFAULT_RESPONSE_TIMEOUT

endif # UART_DFU_SRV

module=UART_DFU_LIBRARY
module-str=UART DFU library
source "${ZEPHYR_BASE}/subsys/logging/Kconfig.template.log_config"


# UART DFU host configuration

config UART_DFU_HOST
	bool "UART DFU host"
	depends on UART_DFU_SRV
	depends on DFU_TARGET
	depends on POLL

config UART_DFU_HOST_MAX_FRAGMENT_SIZE
	int "UART DFU host maximum fragment size."
	default 2048

module=UART_DFU_HOST
module-str=UART DFU host
source "${ZEPHYR_BASE}/subsys/logging/Kconfig.template.log_config"

endmenu
```

## lib/uart_dfu_host/Kconfig
```kconfig
#
# Copyright (c) 2020 Nordic Semiconductor
#
# SPDX-License-Identifier: LicenseRef-BSD-5-Clause-Nordic
#

menu "UART DFU host"

# UART DFU host configuration

config UART_DFU_HOST
	bool "UART DFU host"
	depends on UART_BLOB_RX
	depends on DFU_TARGET
	depends on POLL

config UART_DFU_HOST_MAX_FRAGMENT_SIZE
	int "UART DFU host maximum fragment size."
	default 2048

module=UART_DFU_HOST
module-str=UART DFU host
source "${ZEPHYR_BASE}/subsys/logging/Kconfig.template.log_config"

endmenu
```

## samples/bluetooth/peripheral_uart_dfu/Kconfig
```kconfig
#
# Copyright (c) 2020 Nordic Semiconductor ASA
#
# SPDX-License-Identifier: LicenseRef-BSD-5-Clause-Nordic
#

menu "nRF9160 DK UART DFU nRF52 sample"

config DFU_THREAD
	bool "Spawn a separate thread for calling DFU target functions"
	default y
	select RING_BUFFER
	help
	  If enabled, a separate thread will be spawned for progressively
	  storing a DFU image. Data transferred over GATT will be copied to
	  a ring buffer in order to minimize blocking of the BT RX thread.
	  If disabled, all DFU processing will remain in the BT RX thread,
	  which can be more efficient, but is risky.

config DFU_THREAD_PRIO
	int "Priority level of the DFU thread"
	default 0
	depends on DFU_THREAD

config DFU_THREAD_BUF_SIZE
	int "Size (in bytes) of the ring buffer used by the DFU thread"
	default 512
	depends on DFU_THREAD

endmenu

menu "Zephyr Kernel"
source "Kconfig.zephyr"
endmenu
```

## samples/nrf9160/uart_application_update/Kconfig
```kconfig
#
# Copyright (c) 2020 Nordic Semiconductor ASA
#
# SPDX-License-Identifier: LicenseRef-BSD-5-Clause-Nordic
#

menu "HTTP/UART application update sample"

config DOWNLOAD_HOST
	string "Download host name"

config DOWNLOAD_NRF91_FILE
	string "The file name of the nRF91 firmware image."

config DOWNLOAD_NRF52_FILE
	string "The file name of the nRF52 firmware image."

config APPLICATION_VERSION
	int "Application version"
	default 1

config USE_HTTPS
	bool
	prompt "Use HTTPS for download"

endmenu

menu "Zephyr Kernel"
source "Kconfig.zephyr"
endmenu
```

## tests/lib/uart_dfu/testcase.yaml
```yaml
tests:
  lib.lte_uart_dfu:
    platform_whitelist: qemu_cortex_m3 native_posix
    tags: dfu uart
```

## tests/lib/uart_dfu/uart_dfu_host/testcase.yaml
```yaml
tests:
  uart_dfu.uart_dfu_host:
    platform_whitelist: qemu_cortex_m3 native_posix
    tags: uart dfu uart_dfu_host
```

## tests/subsys/dfu/dfu_target_uart/testcase.yaml
```yaml
tests:
  dfu.dfu_target_uart:
    platform_whitelist: qemu_cortex_m3 native_posix
    tags: dfu uart
```
