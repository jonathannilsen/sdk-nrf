## CMakeLists.txt
```
# Copyright (c) 2026 Nordic Semiconductor
# SPDX-License-Identifier: LicenseRef-Nordic-5-Clause

cmake_minimum_required(VERSION 3.20.0)

find_package(Zephyr REQUIRED HINTS $ENV{ZEPHYR_BASE})
project(call_minimal)

target_sources(app
  PRIVATE
  src/main.c
)
```

## prj.conf
```kconfig
# Enable logging
CONFIG_LOG=y

# Enable ztest
CONFIG_ZTEST=y

# Useful for double checking the code location in the disassembly
CONFIG_OUTPUT_DISASSEMBLY=y

# Enable the minimal call driver.
CONFIG_IRONSIDE_SE_CALL_MINIMAL=y

CONFIG_MULTITHREADING=n
```

## boards/nrf54h20dk_nrf54h20_cpuapp.overlay
```dts
/* Copyright (c) 2026 Nordic Semiconductor ASA
 * SPDX-License-Identifier: LicenseRef-Nordic-5-Clause
 */

/* Disable zephyr drivers for IronSide Call / BELLBOARDs (mbox) */
&psa_rng {
	status = "disabled";
};

&cpusec_cpuapp_ipc {
	status = "disabled";
};

&cpusec_bellboard {
	status = "disabled";
};

/* Disable interrupt for IronSide IPC RX event.
 * Others are kept as they are in the board defaults.
 */
&cpuapp_bellboard {
	/* irq0:
	 *  - 6:  cpuapp-cpusys
	 *  - 13: cpuapp-cpuppr
	 *  - 14: cpuapp-cpuflpr
	 *  - 18: cpuapp-cpurad
	 */
	nordic,interrupt-mapping = <0x00046040 0>;
};
```

## boards/nrf54h20dk_nrf54h20_cpurad.overlay
```dts
/* Copyright (c) 2026 Nordic Semiconductor ASA
 * SPDX-License-Identifier: LicenseRef-Nordic-5-Clause
 */

/* Disable zephyr drivers for IronSide Call / BELLBOARDs (mbox) */
&psa_rng {
	status = "disabled";
};

&cpusec_cpurad_ipc {
	status = "disabled";
};

&cpusec_bellboard {
	status = "disabled";
};

/* Disable interrupt for IronSide IPC RX event.
 * Others are kept as they are in the board defaults.
 */
&cpurad_bellboard {
	/* irq0: 6: cpurad-cpusys, 12: cpurad-cpuapp */
	nordic,interrupt-mapping = <0x00001040 0>;
};
```

## src/main.c
```c
/*
 * Copyright (c) 2026 Nordic Semiconductor ASA.
 *
 * SPDX-License-Identifier: LicenseRef-Nordic-5-Clause
 */

#include <stdint.h>
#include <zephyr/ztest.h>
#include <ironside/se/api.h>

ZTEST(call_minimal, test_call_minimal_driver_works)
{
	struct ironside_se_periphconf_status status;
	struct periphconf_entry entries[] = {
		{ PERIPHCONF_IRQMAP_IRQ_SINK_REGPTR(200) },
		{ PERIPHCONF_IRQMAP_IRQ_SINK_REGPTR(201) },
		{ PERIPHCONF_IRQMAP_IRQ_SINK_REGPTR(202) },
		{ PERIPHCONF_IRQMAP_IRQ_SINK_REGPTR(203) },
		{ PERIPHCONF_IRQMAP_IRQ_SINK_REGPTR(204) },
		{ PERIPHCONF_IRQMAP_IRQ_SINK_REGPTR(205) },
		{ PERIPHCONF_IRQMAP_IRQ_SINK_REGPTR(206) },
		{ PERIPHCONF_IRQMAP_IRQ_SINK_REGPTR(207) },
	};

	BUILD_ASSERT(sizeof(entries) > IRONSIDE_SE_PERIPHCONF_INLINE_READ_MAX_COUNT);

	status = ironside_se_periphconf_read(entries, IRONSIDE_SE_PERIPHCONF_INLINE_READ_MAX_COUNT);
	printk("inline read status: %d\n", status.status);
	zassert_equal(status.status, 0);

	printk("entries:\n");
	for (int i = 0; i < IRONSIDE_SE_PERIPHCONF_INLINE_READ_MAX_COUNT; i++) {
		printk("  %d | 0x%08x: 0x%08x\n", i, entries[i].regptr, entries[i].value);
		entries[i].value = 0;
	}

	status = ironside_se_periphconf_read(entries, ARRAY_SIZE(entries));
	printk("buffer read status: %d\n", status.status);
	zassert_equal(status.status, 0);

	printk("entries:\n");
	for (int i = 0; i < ARRAY_SIZE(entries); i++) {
		printk("  %d | 0x%08x: 0x%08x\n", i, entries[i].regptr, entries[i].value);
		entries[i].value = 0;
	}
}

ZTEST_SUITE(call_minimal, NULL, NULL, NULL, NULL, NULL);
```
