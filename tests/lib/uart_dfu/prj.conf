## CMakeLists.txt
```
#
# Copyright (c) 2020 Nordic Semiconductor
#
# SPDX-License-Identifier: LicenseRef-BSD-5-Clause-Nordic
#

cmake_minimum_required(VERSION 3.13.1)

find_package(Zephyr REQUIRED HINTS $ENV{ZEPHYR_BASE})
project(lib_uart_dfu_test)

# test_runner_generate(src/main.c)

# cmock_handle(${ZEPHYR_BASE}/include/drivers/uart.h uart)

FILE(GLOB app_sources src/*.c)
target_sources(app PRIVATE ${app_sources})

target_include_directories(app
  PRIVATE
  ${ZEPHYR_BASE}/../nrf/include
  ${ZEPHYR_BASE}/../nrf/lib/lte_uart_dfu
  )

target_compile_options(app
  PRIVATE
  -DCONFIG_LTE_UART_DFU_UART_LABEL="UART_1"
  -DCONFIG_UART_ASYNC_API=1
  )
```

## prj.conf
```kconfig
#
# Copyright (c) 2020 Nordic Semiconductor ASA
#
# SPDX-License-Identifier: LicenseRef-BSD-5-Clause-Nordic
#
CONFIG_ZTEST=y
```

## src/uart_dfu_stub.c
```c
/* needed here so the static device_get_binding does not get renamed */
#include <device.h>
#include <drivers/uart.h>

/* Forward declare functions to be replaced. */
struct device *device_get_binding_stub(const char *name);
int uart_callback_set_stub(struct device *dev,
				    	   uart_callback_t callback,
				    	   void *user_data);
int uart_tx_stub(struct device *dev,
                 const u8_t *buf,
                 size_t len,
                 s32_t timeout);
int uart_rx_enable_stub(struct device *dev,
                        u8_t *buf,
                        size_t len,
                        s32_t timeout);
int uart_rx_disable_stub(struct device *dev);
int uart_rx_buf_rsp_stub(struct device *dev,
                         u8_t *buf,
                         size_t len);


/* Redefine the functions for this source file. */
#define device_get_binding device_get_binding_stub
#define uart_callback_set uart_callback_set_stub
#define uart_tx uart_tx_stub
#define uart_rx_enable uart_rx_enable_stub
#define uart_rx_disable uart_rx_disable_stub
#define uart_rx_buf_rsp uart_rx_buf_rsp_stub


/* file itself */
#include "uart_dfu.c"
```
