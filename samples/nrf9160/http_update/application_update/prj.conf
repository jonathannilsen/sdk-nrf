## Kconfig
```
#
# Copyright (c) 2019 Nordic Semiconductor ASA
#
# SPDX-License-Identifier: LicenseRef-Nordic-5-Clause
#

menu "HTTP application update sample"

config DOWNLOAD_HOST
	string "Application update host name"
	help
	  Host part of URL to application update binary. For example
	  if the file is stored in http://foo.bar/update.bin the value
	  of this configuration should be 'foo.bar'

config DOWNLOAD_FILE
	string "Application update file name (version 2)"
	help
	  File part of URL to application update binary version 2. For example
	  if the file is stored in http://foo.bar/update.bin the value
	  of this configuration should be 'update.bin'

config DOWNLOAD_DOWNGRADE_FILE
	string "Application update file name (version 1)"
	help
	  File part of URL to application update binary version 1. For example
	  if the file is stored in http://foo.bar/update_downgrade.bin the value
	  of this configuration should be 'update_downgrade.bin'

config APPLICATION_VERSION
	int "Application version"
	default 1

config USE_HTTPS
	bool
	prompt "Use HTTPS for download"

endmenu

menu "Zephyr Kernel"
source "Kconfig.zephyr"
endmenu
```

## prj.conf
```kconfig
#
# Copyright (c) 2019 Nordic Semiconductor ASA
#
# SPDX-License-Identifier: LicenseRef-Nordic-5-Clause
#
# General config
CONFIG_NCS_SAMPLES_DEFAULTS=y
CONFIG_REBOOT=y

# Network
CONFIG_NETWORKING=y
CONFIG_NET_SOCKETS=y
CONFIG_NET_NATIVE=n

# LTE link control
CONFIG_LTE_LINK_CONTROL=y
CONFIG_LTE_AUTO_INIT_AND_CONNECT=n

# Modem library
CONFIG_NRF_MODEM_LIB=y
CONFIG_NRF_MODEM_LIB_SYS_INIT=n

# Library for buttons and LEDs
CONFIG_DK_LIBRARY=y
CONFIG_DK_LIBRARY_INVERT_LEDS=n

# Heap and stacks
CONFIG_HEAP_MEM_POOL_SIZE=2048
CONFIG_MAIN_STACK_SIZE=8192

# Image manager
CONFIG_IMG_MANAGER=y
CONFIG_FLASH=y
CONFIG_IMG_ERASE_PROGRESSIVELY=y

# GPIO
CONFIG_GPIO=y

# FOTA library
CONFIG_FOTA_DOWNLOAD=y

# Download client
CONFIG_DOWNLOAD_CLIENT=y
CONFIG_DOWNLOAD_CLIENT_STACK_SIZE=4096

# DFU Target
CONFIG_DFU_TARGET=y

# Modem key management
CONFIG_MODEM_KEY_MGMT=y

# Application Upgrade support
CONFIG_BOOTLOADER_MCUBOOT=y

# Sample configuration
CONFIG_DOWNLOAD_HOST="nrfconnectsdk.s3.eu-central-1.amazonaws.com"
CONFIG_DOWNLOAD_FILE="app_update_tmp.bin"
CONFIG_DOWNLOAD_DOWNGRADE_FILE="app_update_downgrade_tmp.bin"
CONFIG_APPLICATION_VERSION=1
```

## src/main.c
```c
/*
 * Copyright (c) 2019 Nordic Semiconductor ASA
 *
 * SPDX-License-Identifier: LicenseRef-Nordic-5-Clause
 */
#include <zephyr.h>
#include <dfu/mcuboot.h>
#include <dfu/dfu_target_mcuboot.h>
#include <modem/nrf_modem_lib.h>
#include <net/fota_download.h>
#include <stdio.h>
#include "update.h"

#if CONFIG_APPLICATION_VERSION == 2
#define NUM_LEDS 2
#else
#define NUM_LEDS 1
#endif

static uint8_t fota_buf[512];

static const char *get_file(void)
{
#if CONFIG_APPLICATION_VERSION == 2
	return CONFIG_DOWNLOAD_DOWNGRADE_FILE;
#else
	return CONFIG_DOWNLOAD_FILE;
#endif
}

static void fota_dl_handler(const struct fota_download_evt *evt)
{
	switch (evt->id) {
	case FOTA_DOWNLOAD_EVT_ERROR:
		printk("Received error from fota_download\n");
		/* Fallthrough */
	case FOTA_DOWNLOAD_EVT_FINISHED:
		update_sample_done();
		break;

	default:
		break;
	}
}

static void update_start(void)
{
	int err;
	char *apn = NULL;
	const char *filename = get_file();

	err = fota_download_start(CONFIG_DOWNLOAD_HOST, filename,
				  SEC_TAG, apn, 0);
	if (err != 0) {
		update_sample_done();
		printk("fota_download_start() failed, err %d\n", err);
	}
}

void main(void)
{
	int err;

	printk("HTTP application update sample started\n");

	err = nrf_modem_lib_init(NORMAL_MODE);
	if (err) {
		printk("Failed to initialize modem library!");
		return;
	}
	/* This is needed so that MCUBoot won't revert the update */
	boot_write_img_confirmed();

	err = dfu_target_mcuboot_set_buf(fota_buf, sizeof(fota_buf));
	if (err != 0) {
		printk("dfu_target_mcuboot_set_buf() failed, err %d\n", err);
		return;
	}

	err = fota_download_init(fota_dl_handler);
	if (err != 0) {
		printk("fota_download_init() failed, err %d\n", err);
		return;
	}

	err = update_sample_init(&(struct update_sample_init_params){
					.update_start = update_start,
					.num_leds = NUM_LEDS
				});
	if (err != 0) {
		printk("update_sample_init() failed, err %d\n", err);
		return;
	}

	printk("Press Button 1 to perform application firmware update\n");
}
```
