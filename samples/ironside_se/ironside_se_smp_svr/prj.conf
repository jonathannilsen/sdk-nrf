## CMakeLists.txt
```
#
# Copyright (c) 2026 Nordic Semiconductor ASA
#
# SPDX-License-Identifier: LicenseRef-Nordic-5-Clause
#

cmake_minimum_required(VERSION 3.20.0)

find_package(Zephyr REQUIRED HINTS $ENV{ZEPHYR_BASE})
project(ironside_se_smp_svr)

target_sources(app PRIVATE src/main.c)
```

## sample.yaml
```
sample:
  name: IronSide SE firmware update using SMP Server
  description: >
    Demonstrates updating IronSide SE firmware over UART using a custom
    MCUmgr command group registered on top of the SMP server.
tests:
  sample.ironside_se.smp_svr:
    build_only: true
    integration_platforms:
      - nrf54h20dk/nrf54h20/cpuapp
    platform_allow:
      - nrf54h20dk/nrf54h20/cpuapp
    tags:
      - ci_build
```

## prj.conf
```kconfig
#
# Copyright (c) 2026 Nordic Semiconductor ASA
#
# SPDX-License-Identifier: LicenseRef-Nordic-5-Clause
#

# MCUmgr / SMP core
CONFIG_MCUMGR=y
CONFIG_NET_BUF=y
CONFIG_ZCBOR=y
CONFIG_CRC=y

# SMP UART transport
CONFIG_BASE64=y
CONFIG_MCUMGR_TRANSPORT_UART=y
CONFIG_UART_MCUMGR_RX_BUF_COUNT=4

# OS management group (provides reset command)
CONFIG_MCUMGR_GRP_OS=y

# Flash support for staging area writes
CONFIG_FLASH=y
CONFIG_FLASH_MAP=y
CONFIG_STREAM_FLASH=y

# IronSide SE update MCUmgr group
CONFIG_MGMT_IRONSIDE_SE_UPDATE=y

# Stack sizes – MCUmgr handlers need room
CONFIG_SYSTEM_WORKQUEUE_STACK_SIZE=4096
CONFIG_MAIN_STACK_SIZE=2048

# Logging over UART (multiplexed with SMP on the same port)
CONFIG_LOG=y
CONFIG_CONSOLE=y

CONFIG_PSA_CRYPTO=y
CONFIG_PSA_WANT_GENERATE_RANDOM=y

# Disable Oberon PSA crypto drivers
CONFIG_PSA_CRYPTO_DRIVER_OBERON=n

# Enable PSA crypto from SSF client
CONFIG_PSA_SSF_CRYPTO_CLIENT=y

# Mbedtls configuration
CONFIG_MBEDTLS_ENABLE_HEAP=y
CONFIG_MBEDTLS_HEAP_SIZE=8192
```

## boards/nrf54h20dk_nrf54h20_cpuapp.overlay
```dts
/*
 * Define an IronSide SE update staging partition in the valid update
 * address range (0x0e100000 – 0x0e1d8000 on nRF54H20).
 *
 * The secondary MCUboot slots that occupy the same region by default
 * are removed because this sample does not use MCUboot DFU.
 */

/delete-node/ &cpuapp_slot1_partition;
/delete-node/ &cpurad_slot1_partition;

&mram1x {
	partitions {
		ironside_se_update_partition: partition@100000 {
			reg = <0x100000 0x28000>; /* 160 KiB */
		};
	};
};
```

## src/main.c
```c
/*
 * Copyright (c) 2026 Nordic Semiconductor ASA
 *
 * SPDX-License-Identifier: LicenseRef-Nordic-5-Clause
 */

#include <zephyr/kernel.h>
#include <zephyr/logging/log.h>

LOG_MODULE_REGISTER(ironside_se_smp_svr, LOG_LEVEL_INF);

int main(void)
{
	LOG_INF("IronSide SE SMP server ready (build: " __DATE__ " " __TIME__ ")");
	return 0;
}
```
